## drivers/input/touchscreen/mediatek/Kconfig
```kconfig
#
# Touchscreen driver configuration
#
menuconfig INPUT_TOUCHSCREEN
	bool "Touchscreens"
	help
	  Say Y here, and a list of supported touchscreens will be displayed.
	  This option doesn't affect the kernel.

	  If unsure, say Y.

if INPUT_TOUCHSCREEN

config TOUCHSCREEN_MTK
	bool "MediaTek Touch Panel Driver"
	help
	  Say Y here if you have MediaTek touch panel.

	  If unsure, say N.

	  To compile this dirver as a module, choose M here: the
	  module will be called.

config TOUCHSCREEN_MTK_MSG22XX
	bool "MSG22XX for Mediatek package"
	default n
	help
	  Say Y here if you have msg2xx touch panel.

	  If unsure, say N.

	  To compile this dirver as a module, choose M here: the
	  module will be called.

config TOUCHSCREEN_MTK_MSG22XX_64
	bool "MSG22XX for Mediatek package"
	default n
	help
	  Say Y here if you have msg2xx touch panel.

	  If unsure, say N.

	  To compile this dirver as a module, choose M here: the
	  module will be called.

config TOUCHSCREEN_MTK_FT5X0X
	bool "FT5X0X for Mediatek package"
	default n
	help
	  Say Y here if you have FT5X0X touch panel.

	  If unsure, say N.

	  To compile this dirver as a module, choose M here: the
	  module will be called.

source "drivers/input/touchscreen/mediatek/ft5x0x/Kconfig"

config TOUCHSCREEN_MTK_FT6336U
	bool "FT6336U for Mediatek package"
	default n
	help
	  Say Y here if you have FT6336U touch panel.

	  If unsure, say N.

	  To compile this dirver as a module, choose M here: the
	  module will be called.

source "drivers/input/touchscreen/mediatek/ft6336u/Kconfig"

config TOUCHSCREEN_MTK_MSG2238A
	bool "MSG2238A for Mediatek package"
	default n
	help
	  Say Y here if you have MSG2238A touch panel.
	  If unsure, say N.

	  To compile this dirver as a module, choose M here: the
	  module will be called.

config TOUCHSCREEN_MTK_FOCALTECH_TS
	bool "FOCALTECH_TS for Mediatek package"
	default n
	help
	  Say Y here if you have focaltech_touch touch panel.

	  If unsure, say N.

	  To compile this dirver as a module, choose M here: the
	  module will be called.

source "drivers/input/touchscreen/mediatek/focaltech_touch/Kconfig"

endif
```
